## boards/shields/prototype_mk1/Kconfig.defconfig
```kconfig
# Copyright (c) 2020 Ryan Cross
# SPDX-License-Identifier: MIT

if SHIELD_MY_KEYBOARD_DONGLE

# Max 16 characters in keyboard name
config ZMK_KEYBOARD_NAME
    default "Prototype_Mk1"

config ZMK_SPLIT_ROLE_CENTRAL
    default y

config ZMK_SPLIT
    default y

config ZMK_SPLIT_BLE_CENTRAL_PERIPHERALS
    default 2

# Set this to ZMK_SPLIT_BLE_CENTRAL_PERIPHERALS + your desired number of BT profiles (default is 5)
config BT_MAX_CONN
    default 3

# Set this to the same number as BT_MAX_CONN
config BT_MAX_PAIRED
    default 3

endif

if SHIELD_PROTOTYPE_MK1_LEFT
config ZMK_KEYBOARD_NAME
    default "Prototype_Mk1"
config ZMK_SPLIT_ROLE_CENTRAL
    default y
endif

if SHIELD_PROTOTYPE_MK1_LEFT || SHIELD_PROTOTYPE_MK1_RIGHT || SHIELD_MY_KEYBOARD_DONGLE
config ZMK_SPLIT
    default y

if ZMK_DISPLAY
config I2C
    default y
config SSD1306
    default y
endif # ZMK_DISPLAY

if LVGL
config LV_Z_VDB_SIZE
    default 64
config LV_DPI_DEF
    default 148
config LV_Z_BITS_PER_PIXEL
    default 1
choice LV_COLOR_DEPTH
    default LV_COLOR_DEPTH_1
endchoice

endif # LVGL
if ZMK_BACKLIGHT
config PWM
    default y
config LED_PWM
    default y
endif

endif
```

## config/west.yml
```yaml
manifest:
  remotes:
    - name: zmkfirmware
      url-base: https://github.com/zmkfirmware
    - name: mctechnology17
      url-base: https://github.com/mctechnology17
#    - name: m165437 #new entry
#      url-base: https://github.com/M165437 #new entry
  projects:
    - name: zmk
      remote: zmkfirmware
      revision: main
      import: app/west.yml
    - name: zmk-oled-adapter
      remote: mctechnology17
      revision: main
#    - name: nice-view-gem #new entry
#      remote: m165437 #new entry
#      revision: main #new entry
  self:
    path: config
```
